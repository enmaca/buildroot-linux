## package/thirdparty/plugin_browser_undermedia/Config.in
```kconfig
config BR2_PACKAGE_PLUGIN_BROWSER_UNDERMEDIA
depends on BR2_PACKAGE_XBMC
        bool "XBMC Undermedia Browser"
```

## package/thirdparty/repository-undermedia-addons/Config.in
```kconfig
config BR2_PACKAGE_REPOSITORY_UNDERMEDIA_ADDONS
depends on BR2_PACKAGE_XBMC
        bool "XBMC Repository Undermedia Addons"
```

## package/thirdparty/repository_undermedia_addons/Config.in
```kconfig
config BR2_PACKAGE_REPOSITORY_UNDERMEDIA_ADDONS
depends on BR2_PACKAGE_XBMC
depends on BR2_PACKAGE_PLUGIN_BROWSER_UNDERMEDIA
depends on BR2_PACKAGE_SCRIPT_MODULE_XBMCSWIFT2
depends on BR2_PACKAGE_SCRIPT_MODULE_UNDERMEDIA
        bool "XBMC Repository Undermedia Addons"
```

## package/thirdparty/script_module_undermedia/Config.in
```kconfig
config BR2_PACKAGE_SCRIPT_MODULE_UNDERMEDIA
depends on BR2_PACKAGE_XBMC
        bool "XBMC Script Module Undermedia"
```

## package/thirdparty/script_module_xbmcswift2/Config.in
```kconfig
config BR2_PACKAGE_SCRIPT_MODULE_XBMCSWIFT2
depends on BR2_PACKAGE_XBMC
        bool "XBMCSWIFT Script Plugin"
```

## package/thirdparty/xbmc-undermedia/Config.in
```kconfig
config BR2_PACKAGE_XBMC_UNDERMEDIA
depends on BR2_PACKAGE_XBMC
        bool "XBMC Undermedia Addons"
```
